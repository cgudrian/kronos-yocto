## sources/meta-kronos/conf/distro/kronos.conf
```bitbake
DISTRO = "kronos"
DISTRO_NAME = "KRON*OS"
DISTRO_VERSION = "1.0"
DISTRO_CODENAME = "starink"

TARGET_VENDOR = "-kronos"

DISTRO_FEATURES = "\
    ext2 \
    ipv4 \
    largefile \
    ldconfig \
    pci \
    sysvinit \
    usbhost \
    vfat \
    zeroconf \
"

PREFERRED_VERSION_linux-kronos = "2.6.32%"
OLDEST_KERNEL = "2.6.32"

require conf/distro/include/no-static-libs.inc
require conf/distro/include/yocto-uninative.inc
require conf/distro/include/security_flags.inc
INHERIT += "uninative"

INHERIT += "reproducible_build"
```

## sources/meta-kronos/conf/layer.conf
```bitbake
# We have a conf and classes directory, add to BBPATH
BBPATH =. "${LAYERDIR}:"

# We have recipes-* directories, add to BBFILES
BBFILES += "${LAYERDIR}/recipes-*/*/*.bb \
            ${LAYERDIR}/recipes-*/*/*.bbappend"

BBFILE_COLLECTIONS += "kronos-layer"
BBFILE_PATTERN_kronos-layer = "^${LAYERDIR}/"
BBFILE_PRIORITY_kronos-layer = "5"

LAYERSERIES_COMPAT_kronos-layer = "dunfell"

# This should only be incremented on significant changes that will
# cause compatibility issues with other layers
LAYERVERSION_kronos-layer = "1"

REQUIRED_POKY_BBLAYERS_CONF_VERSION = "2"
```

## sources/meta-kronos/conf/machine/korg-kronos.conf
```bitbake
require conf/machine/genericx86.conf

PREFERRED_PROVIDER_virtual/kernel = "linux-kronos"

#PREFERRED_VERSION_binutils-cross-${TARGET_ARCH} = "2.20.1"
#PREFERRED_VERSION_gcc-cross-${TARGET_ARCH} = "4.5.0"
```
